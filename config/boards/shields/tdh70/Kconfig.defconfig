## config/boards/shields/tdh70/Kconfig.defconfig
```kconfig
# Copyright (c) 2020 Ryan Cross
# SPDX-License-Identifier: MIT

if SHIELD_DONGLE

config ZMK_KEYBOARD_NAME
	default "TDH70 Dongle"
	
config ZMK_SPLIT_BLE_ROLE_CENTRAL
	default y
	
config ZMK_USB
	default y

endif


if SHIELD_DONGLE || SHIELD_TDH70_LEFT || SHIELD_TDH70_RIGHT

config ZMK_SPLIT
	default y

config ZMK_BLE
	default y

endif
```
